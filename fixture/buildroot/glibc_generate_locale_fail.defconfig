## fixture/buildroot/glibc_generate_locale_fail.defconfig
```kconfig
## This fixture should fail. BR2_GENERATE_LOCALE should be n if BR2_TOOLCHAIN_USES_GLIBC is y
BR2_GENERATE_LOCALE=
BR2_TOOLCHAIN_EXTERNAL_CUSTOM_GLIBC=y
```
